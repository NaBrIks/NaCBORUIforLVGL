## examples/lilygo_t_display_s3/sdkconfig.defaults
```kconfig
CONFIG_IDF_TARGET="esp32s3"
CONFIG_ESP_DEFAULT_CPU_FREQ_MHZ_240=y
CONFIG_ESPTOOLPY_FLASHSIZE_16MB=y
CONFIG_SPIRAM=y
CONFIG_SPIRAM_MODE_OCT=y
CONFIG_SPIRAM_SPEED_80M=y
# CONFIG_COMPILER_CXX_EXCEPTIONS is not set
CONFIG_ESP_CONSOLE_USB_SERIAL_JTAG=y
CONFIG_ESP_CONSOLE_SECONDARY_NONE=y
CONFIG_FREERTOS_HZ=1000
CONFIG_ESP_MAIN_TASK_STACK_SIZE=16384
CONFIG_LV_COLOR_DEPTH_UNSET=y
CONFIG_LV_COLOR_FORMAT_RGB565=y
CONFIG_LV_USE_BUILTIN_MALLOC=n
CONFIG_LV_USE_CLIB_MALLOC=y
CONFIG_LV_ASSERT_HANDLER_INCLUDE=""
CONFIG_LV_FONT_MONTSERRAT_14=y
CONFIG_LV_FONT_MONTSERRAT_12=y
CONFIG_LV_FONT_MONTSERRAT_20=y
CONFIG_LV_FONT_MONTSERRAT_28=y
CONFIG_LV_USE_FLEX=y
CONFIG_LV_USE_GRID=y
CONFIG_LV_USE_XML=n
CONFIG_LV_USE_OBJ_PROPERTY=n
CONFIG_LV_USE_OBJ_PROPERTY_NAME=n
CONFIG_BT_ENABLED=n
CONFIG_LV_THEME_DEFAULT_TRANSITION_TIME=0
```

## examples/lilygo_t_display_s3/sdkconfig.defaults.ws
```kconfig
CONFIG_NAWSERVER_WEBSOCKET=y
CONFIG_NAWSERVER_TCP_MANAGED=y
CONFIG_ESP_SYSTEM_EVENT_TASK_STACK_SIZE=4096
```

## examples/memory_bench/sdkconfig.defaults
```kconfig
CONFIG_IDF_TARGET="esp32s3"
CONFIG_ESP_DEFAULT_CPU_FREQ_MHZ_240=y
CONFIG_ESPTOOLPY_FLASHSIZE_16MB=y
CONFIG_SPIRAM=y
CONFIG_SPIRAM_MODE_OCT=y
CONFIG_SPIRAM_SPEED_80M=y
CONFIG_SPIRAM_FETCH_INSTRUCTIONS=y
CONFIG_SPIRAM_RODATA=y
CONFIG_SPIRAM_MALLOC_ALWAYSINTERNAL=0
CONFIG_ESP32S3_DATA_CACHE_64KB=y
CONFIG_ESP32S3_DATA_CACHE_LINE_64B=y
CONFIG_FREERTOS_HZ=1000
CONFIG_ESP_MAIN_TASK_STACK_SIZE=16384
CONFIG_ESP_CONSOLE_USB_SERIAL_JTAG=y
CONFIG_ESP_CONSOLE_SECONDARY_NONE=y
CONFIG_LV_COLOR_FORMAT_RGB565=y
CONFIG_LV_USE_BUILTIN_MALLOC=n
CONFIG_LV_USE_CLIB_MALLOC=y
CONFIG_LV_USE_GIF=y
CONFIG_LV_USE_XML=n
CONFIG_LV_USE_OBJ_PROPERTY=n
CONFIG_LV_USE_OBJ_PROPERTY_NAME=n
CONFIG_NAWSERVER_WEBSOCKET=y
CONFIG_NAWSERVER_TCP_MANAGED=y
CONFIG_NAWSERVER_TCP_HTTP_STACK_SIZE=12288
# CONFIG_LV_USE_TJPGD is not set
# CONFIG_LV_USE_FS_MEMFS is not set
# CONFIG_LV_BUILD_EXAMPLES is not set
# CONFIG_LV_BUILD_DEMOS is not set
```

## examples/s3_style_lab/sdkconfig.defaults
```kconfig
CONFIG_IDF_TARGET="esp32s3"
CONFIG_ESP_DEFAULT_CPU_FREQ_MHZ_240=y
CONFIG_ESPTOOLPY_FLASHSIZE_16MB=y
CONFIG_SPIRAM=y
CONFIG_SPIRAM_MODE_OCT=y
CONFIG_SPIRAM_SPEED_80M=y
CONFIG_SPIRAM_FETCH_INSTRUCTIONS=y
CONFIG_SPIRAM_RODATA=y
CONFIG_SPIRAM_MALLOC_ALWAYSINTERNAL=0
CONFIG_SPIRAM_TRY_ALLOCATE_WIFI_LWIP=y
CONFIG_ESP32S3_DATA_CACHE_64KB=y
CONFIG_ESP32S3_DATA_CACHE_LINE_64B=y
CONFIG_HTTPD_WS_SUPPORT=y
CONFIG_HTTPD_MAX_REQ_HDR_LEN=1024
# CONFIG_ESP_CONSOLE_UART_DEFAULT is not set
CONFIG_FREERTOS_HZ=1000

CONFIG_LV_COLOR_DEPTH_UNSET=y
CONFIG_LV_COLOR_FORMAT_RGB565=y
CONFIG_LV_USE_BUILTIN_MALLOC=n
CONFIG_LV_USE_CLIB_MALLOC=y
CONFIG_LV_ASSERT_HANDLER_INCLUDE=""
CONFIG_LV_FONT_MONTSERRAT_20=y
CONFIG_LV_FONT_MONTSERRAT_28=y

CONFIG_FREERTOS_USE_TRACE_FACILITY=y
CONFIG_FREERTOS_GENERATE_RUN_TIME_STATS=y
CONFIG_FREERTOS_RUN_TIME_STATS_USING_ESP_TIMER=y
CONFIG_FREERTOS_VTASKLIST_INCLUDE_COREID=y
CONFIG_LWIP_MAX_SOCKETS=24

CONFIG_LWIP_MAX_ACTIVE_TCP=32
CONFIG_LV_USE_FLEX=y
CONFIG_LV_USE_GRID=y
CONFIG_ESP_MAIN_TASK_STACK_SIZE=16384
CONFIG_LV_USE_XML=n
CONFIG_LV_USE_OBJ_PROPERTY=n
CONFIG_LV_USE_OBJ_PROPERTY_NAME=n

CONFIG_ESP_CONSOLE_USB_SERIAL_JTAG=y
CONFIG_ESP_CONSOLE_SECONDARY_NONE=y

# Optional yabt scanner demo: passive advertising only, no connections/pairing.
CONFIG_BT_ENABLED=y
CONFIG_BT_BLUEDROID_ENABLED=y
CONFIG_BT_BLE_ENABLED=y
CONFIG_BT_BLE_50_FEATURES_SUPPORTED=y
CONFIG_BT_BLE_42_FEATURES_SUPPORTED=n
CONFIG_BT_GATTC_ENABLE=n
CONFIG_BT_GATTS_ENABLE=n
CONFIG_BT_BLE_SMP_ENABLE=n
CONFIG_BT_ALLOCATION_FROM_SPIRAM_FIRST=y

# Use lwIP's bounded server failover when one NTP endpoint is unavailable.
CONFIG_LWIP_SNTP_MAX_SERVERS=3
```
